## boards/shields/torabo41/Kconfig.defconfig
```kconfig
if SHIELD_TORABO41_RIGHT

config ZMK_KEYBOARD_NAME
    default "torabo41"

endif

if SHIELD_TORABO41_LEFT || SHIELD_TORABO41_RIGHT

config ZMK_SPLIT
    default y

endif
```

## torabo41-akdk/boards/shields/torabo41/Kconfig.shield
```kconfig
config SHIELD_TORABO41_LEFT
    def_bool $(shields_list_contains,torabo41_left)
config SHIELD_TORABO41_RIGHT
    def_bool $(shields_list_contains,torabo41_right)
```
